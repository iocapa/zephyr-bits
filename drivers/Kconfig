## drivers/Kconfig
```kconfig
# Copyright (c) 2022 Ionut Catalin Pavel
# SPDX-License-Identifier: Apache-2.0

menu "Drivers"

rsource "jtag/Kconfig"
rsource "misc/Kconfig"
rsource "sensor/Kconfig"

endmenu
```

## drivers/jtag/Kconfig
```kconfig
# Serial driver configuration options

# Copyright (c) 2014-2015 Wind River Systems, Inc.
# SPDX-License-Identifier: Apache-2.0

menuconfig JTAG
	bool "jtag drivers"
	help
	  Enable options for jtag drivers.

if JTAG

comment "Capabilities"

config JTAG_SUPPORT_ASYNC
	bool
	help
	  This is an option to be enabled by individual jtag driver
	  to signal that the driver and hardware supports async operation.

config JTAG_ASYNC_API
	bool "Asynchronous UART API"
	depends on JTAG_SUPPORT_ASYNC
	help
	  This option enables asynchronous JTAG API.

config JTAG_INIT_PRIORITY
	int "jtag init priority"
	default KERNEL_INIT_PRIORITY_DEVICE
	help
	  jtag driver device initialization priority.

module = JTAG
module-str = jtag
source "subsys/logging/Kconfig.template.log_config"

comment "JTAG drivers"

rsource "Kconfig.rpi_pico_pio"

endif # JTAG
```

## drivers/jtag/Kconfig.rpi_pico_pio
```kconfig
# Copyright (c) 2023 Ionut Pavel
# SPDX-License-Identifier: Apache-2.0

config JTAG_RPI_PICO_PIO
	bool "Raspberry Pi PIO jtag controller driver"
	depends on DT_HAS_RASPBERRYPI_PICO_PIO_JTAG_ENABLED
	select JTAG_SUPPORT_ASYNC
	select DMA
	default y

if JTAG_RPI_PICO_PIO

config JTAG_RPI_PICO_MINIMAL_INSTR
	bool "Reduce instruction count mode"
	help
	  This reduces instruction usage a bit but introduces
	  uneven clock pulses and relative lower throughput.
	  Say Y only if drivers fail initialization.

endif # JTAG_RPI_PICO_PIO
```

## drivers/misc/Kconfig
```kconfig
# Copyright (c) 2022 Ionut Catalin Pavel
# SPDX-License-Identifier: Apache-2.0

menu "Misc Drivers"

rsource "cdc_acm_pt/Kconfig"
rsource "cmsis_dap/Kconfig"

endmenu
```

## drivers/misc/cdc_acm_pt/Kconfig
```kconfig
# Copyright (c) 2016 Wind River Systems, Inc.
# SPDX-License-Identifier: Apache-2.0

menu "USB CDC ACM UART passthrough"

config USB_CDC_ACM_PT
	bool "USB CDC ACM Class support"
	default y
	depends on SERIAL
	depends on DT_HAS_ZEPHYR_CDC_ACM_UART_PT_ENABLED
	select SERIAL_HAS_DRIVER
	select SERIAL_SUPPORT_INTERRUPT
	select RING_BUFFER
	select UART_INTERRUPT_DRIVEN
	select UART_USE_RUNTIME_CONFIGURE
	help
	  USB CDC ACM class with uart passthrough support.

if USB_CDC_ACM_PT

config CDC_ACM_PT_ACT_CALLBACK_SUPPORT
	bool "Support callbacks when there is activity on the serial line"
	help
	  If set, enables support for a callback that is invoked when data is passed.

config CDC_ACM_PT_INTERRUPT_EP_MPS
	int
	default 16
	help
	  CDC ACM class interrupt IN endpoint size

config CDC_ACM_PT_BULK_EP_MPS
	int
	default 512 if USB_DC_HAS_HS_SUPPORT
	default 64
	help
	  CDC ACM class bulk endpoints size

config CDC_ACM_PT_IAD
	bool "Force using Interface Association Descriptor"
	default CDC_ACM_IAD if USB_CDC_ACM
	default y
	help
	  IAD should not be required for non-composite CDC ACM device,
	  but Windows 7 fails to properly enumerate without it.
	  Enable if you want CDC ACM to work with Windows 7.

module = USB_CDC_ACM_PT
module-str = usb-cdc-acm-pt
source "subsys/logging/Kconfig.template.log_config"

endif # USB_CDC_ACM_PT

endmenu
```

## drivers/misc/cmsis_dap/Kconfig
```kconfig
# Copyright (c) 2023 Ionut Catalin Pavel
# SPDX-License-Identifier: Apache-2.0

config USB_CMSIS_DAP
	bool "Zephyr CMSIS-DAP v2 USB interface"
	default y
	depends on DT_HAS_ZEPHYR_CMSIS_DAP_ENABLED
	select USB_DEVICE_STACK
	help
	  Setting this value will enable driver support 
	  for a CMSIS-DAP v2 USB interface

if USB_CMSIS_DAP

config USB_CMSIS_DAP_MSOS20_BOS_SUPPORT
	bool "Enable MS-OS 2.0 BOS descriptor support"
	select USB_DEVICE_BOS
	help
	  Enable MS-OS 2.0 automatic driver installation based on GUIDs

config USB_CMSIS_DAP_THREAD_STACK_SIZE
	int "CMSIS-DAP thread stack size"
	default 1024
	help
	  Stack size for the CMSIS-DAP instance thread

config USB_CMSIS_DAP_THREAD_PRIORITY
	int "CMSIS-DAP thread stack priority"
	default 10
	help
	  Priority for the CMSIS-DAP instance thread

config USB_CMSIS_DAP_BULK_EP_MPS
	int
	default 512 if USB_DC_HAS_HS_SUPPORT
	default 64
	help
	  CMSIS-DAP bulk endpoints size

config USB_CMSIS_DAP_PACKET_SIZE
	int "CMSIS-DAP packet size"
	default 512 if USB_DC_HAS_HS_SUPPORT
	default 64
	help
	  CMSIS-DAP Packet size (in bytes).

config USB_CMSIS_DAP_PACKET_COUNT
	int "CMSIS-DAP packet count"
	range 1 127
	default 4
	help
	  CMSIS-DAP Packet count (in packets).

config USB_CMIS_DAP_MAX_JTAG_INSTR
	int "Maximum number of sequential JTAG instructions"
	range 1 128
	default 24
	help
	  Size of the maximum JTAG instruction array.

module = USB_CMSIS_DAP
module-str = usb-cmsis-dap
source "subsys/logging/Kconfig.template.log_config"

endif
```

## drivers/sensor/adc_voltage_divider/Kconfig
```kconfig
# SPDX-License-Identifier: Apache-2.0

config ADC_VOLTAGE_DIVIDER
	bool "ADC based voltage divider sensor"
	default y
	depends on DT_HAS_ZEPHYR_ADC_VOLTAGE_DIVIDER_ENABLED
	depends on ADC
	help
	  Enable driver for ADC resistive divider voltage sensor
```

## dts/bindings/jtag/raspberrypi,pico_pio_jtag.yaml
```yaml
description: Raspberry Pi Pico PIO jtag controller

compatible: "raspberrypi,pico-pio-jtag"

include: [
  "raspberrypi,pico-pio-device.yaml",
  pinctrl-device.yaml,
  base.yaml
]

properties:
  trst-gpios:
    type: phandle-array
    description: |
      Test reset pin.

  default-frequency:
    type: int
    description: |
      Default clock frequency

  srst-gpios:
    type: phandle-array
    description: |
      System reset pin.

  dmas:
    required: true
    description: |
      DMA channels for TX and RX

  dma-names:
    required: true
    description: |
      DMA channels. Needs to be: "tx", "rx".

  queue-size:
    type: int
    default: 32
    description: |
      Number of 32 bit words for the DMA queue.
      Each instruction requires 2 + ((bits_to_shift + 31) / 32) words.
      Should be adjusted based on measurements.
```

## dts/bindings/misc/zephyr,cdc-acm-uart-pt.yaml
```yaml
# Copyright (c) 2021 Nordic Semiconductor ASA
# SPDX-License-Identifier: Apache-2.0

description: USB CDC ACM uart passthrough

compatible: "zephyr,cdc-acm-uart-pt"

include: "zephyr,cdc-acm-uart.yaml"

properties:
  uart:
    required: true
    type: phandle
```

## dts/bindings/misc/zephyr,cmsis-dap.yaml
```yaml
description: CMSIS-DAP USB interface

compatible: "zephyr,cmsis-dap"

on-bus: usb

properties:
  iface-name:
    type: string
    description: |
      Interface name (will appear when enumerated)

  jtag:
    required: true
    type: phandle

  disable-jtag:
    type: boolean
    description: |
      Disable JTAG debug port

  disable-swd:
    type: boolean
    description: |
      Disable SWD debug port
```

## dts/bindings/sensor/zephyr,adc-voltage-divider.yaml
```yaml
description: "ADC based resistive divider voltage sensor"

compatible: "zephyr,adc-voltage-divider"

include:
  - name: sensor-device.yaml
  - name: voltage-divider.yaml
    property-blocklist:
    - power-gpios
```
